## package/vbxhello/src/Config.in
```kconfig
config BR2_PACKAGE_EMBEDDEDINN
    bool "vbxhello"
    help
        vbxhello package.
```

## package/vectorblox/Config.in
```kconfig
# ====================================
# buildroot/package/vectorblox/Config.in
# ====================================
config BR2_EXTERNAL_VECTORBLOX_APPS
    bool "vectorblox"
    help
        Vortex-CoLab applications
```
